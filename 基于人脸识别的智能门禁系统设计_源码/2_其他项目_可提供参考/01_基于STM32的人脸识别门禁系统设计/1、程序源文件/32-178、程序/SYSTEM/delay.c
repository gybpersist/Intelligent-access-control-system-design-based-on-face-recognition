/************************************************
//本程序只供学习使用，未经作者许可，不得用于其它任何用途
//TWKJ STM32开发板
//通旺科技@TWKJ
//作者：tianqingyong
//版本：V1.2
//修改日期:2020/10/22
//程序功能：使用DWT做精准延时
//V1.0 2020/06/06   完成基本功能
//V1.1 2020/09/27   1、支持rt-thread
//V1.2 2020/10/22   1、修复延时0us的bug
************************************************/
#include "delay.h"

/**********************************************************************************************************
*   函 数 名: DWT_Init
*   功能说明: 初始化DWT
*   形    参: 无
*   返 回 值: 无
**********************************************************************************************************/
void DWT_Init(void)
{
    CoreDebug->DEMCR |= CoreDebug_DEMCR_TRCENA_Msk;
    DWT->CYCCNT = 0u;
    DWT->CTRL |= DWT_CTRL_CYCCNTENA_Msk;
}

/**********************************************************************************************************
*   函 数 名: delay_us
*   功能说明: 这里的延时采用CPU的内部计数实现，32位计数器
*               OSSchedLock(&err);
*               delay_us(5);
*               OSSchedUnlock(&err); 根据实际情况看看是否需要加调度锁或选择关中断
*   形    参: usCount  延迟长度，单位1 us
*   返 回 值: 无
*   说    明: 1. 主频72MHz的情况下，32位计数器计满是2^32/72000000 = 59.652秒
*                建议使用本函数做延迟的话，延迟在1秒以下。  
*            2. 两个32位无符号数相减，获取的结果再赋值给32位无符号数依然可以正确的获取差值。
*              假如A,B,C都是32位无符号数。
*              如果A > B  那么A - B = C，这个很好理解，完全没有问题
*              如果A < B  那么A - B = C， C的数值就是0xFFFFFFFF - B + A + 1。这一点要特别注意，正好用于本函数。
**********************************************************************************************************/
void delay_us(u32 usCount)
{
    u32 tCnt, tDelayCnt;
    u32 tStart;
    if(usCount==0)
    {
        return;
    }
    tStart = DWT->CYCCNT;/* 刚进入时的计数器值 */
    tCnt = 0;
    tDelayCnt = usCount * (SystemCoreClock / 1000000)-32;/* 需要的节拍数 -32与实际值最接近*/

    while(tCnt < tDelayCnt)
    {
        tCnt = DWT->CYCCNT - tStart; /* 求减过程中，如果发生第一次32位计数器重新计数，依然可以正确计算 */
    }
}

#if !defined (USE_RT_THREAD)
/**********************************************************************************************************
*   函 数 名: delay_ms
*   功能说明: 这里的延时采用CPU的内部计数实现，32位计数器
*   形    参: msCount  延迟长度，单位1 ms
*   返 回 值: 无
*   说    明: 1. 主频72MHz的情况下，32位计数器计满是2^32/72000000 = 59.652秒
*                使用本函数做延迟的话，msCount最大值为59652。  
*********************************************************************************************************/
void delay_ms(u16 msCount)
{
    delay_us(msCount*1000);
}
#endif

/**********************************************************************************************************
*   函 数 名: delay_sec
*   功能说明: 这里的延时采用CPU的内部计数实现，32位计数器
*   形    参: secCount  延迟长度，单位1 s
*   返 回 值: 无
*********************************************************************************************************/
void delay_sec(u8 secCount)
{
    while(secCount)
    {
        delay_ms(1000);
        secCount--;
    }
}

